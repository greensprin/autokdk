## boards/shields/gridball61lp/Kconfig.defconfig
```kconfig
if SHIELD_GRIDBALL61LP_RIGHT

config ZMK_KEYBOARD_NAME
    default "gridball61lp"

endif

if SHIELD_GRIDBALL61LP_LEFT || SHIELD_GRIDBALL61LP_RIGHT

config ZMK_SPLIT
    default y

endif
```

## boards/shields/gridball61lp/Kconfig.shield
```kconfig
config SHIELD_GRIDBALL61LP_LEFT
    def_bool $(shields_list_contains,gridball61lp_left)
config SHIELD_GRIDBALL61LP_RIGHT
    def_bool $(shields_list_contains,gridball61lp_right)
```
